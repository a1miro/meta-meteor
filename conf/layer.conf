## conf/layer.conf
```bitbake
# We have a conf and classes directory, add to BBPATH
BBPATH .= ":${LAYERDIR}"

# We have recipes-* directories, add to BBFILES
BBFILES += "${LAYERDIR}/recipes-*/*/*.bb \
            ${LAYERDIR}/recipes-*/*/*.bbappend"

BBFILE_COLLECTIONS += "meta-meteor"
BBFILE_PATTERN_meta-meteor = "^${LAYERDIR}/"
BBFILE_PRIORITY_meta-meteor = "6"

LAYERDEPENDS_meta-meteor = "core"
LAYERSERIES_COMPAT_meta-meteor = "scarthgap"
```
